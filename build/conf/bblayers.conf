## build/conf/bblayers.conf
```bitbake
# POKY_BBLAYERS_CONF_VERSION is increased each time build/conf/bblayers.conf
# changes incompatibly
POKY_BBLAYERS_CONF_VERSION = "2"

BBPATH = "${TOPDIR}"
BBFILES ?= ""

BBLAYERS ?= " \
  /home/leon/sandbox/sidebranch/axon/yocto-poky-musl-sdk-cmake/poky-zeus/meta \
  /home/leon/sandbox/sidebranch/axon/yocto-poky-musl-sdk-cmake/poky-zeus/meta-poky \
  /home/leon/sandbox/sidebranch/axon/yocto-poky-musl-sdk-cmake/poky-zeus/meta-yocto-bsp \
  "
```

## meta-fixes/conf/layer.conf
```bitbake
# We have a conf and classes directory, add to BBPATH
BBPATH .= ":${LAYERDIR}"

# We have recipes-* directories, add to BBFILES
BBFILES += "${LAYERDIR}/recipes-*/*/*.bb \
	${LAYERDIR}/recipes-*/*/*.bbappend"

BBFILE_COLLECTIONS += "fixes"
BBFILE_PATTERN_fixes = "^${LAYERDIR}/"
BBFILE_PRIORITY_fixes = "10"

LAYERVERSION_fixes = "5"
LAYERSERIES_COMPAT_fixes = "zeus dunfell"
```

## meta-project/conf/layer.conf
```bitbake
# We have a conf and classes directory, add to BBPATH
BBPATH .= ":${LAYERDIR}"

# We have recipes-* directories, add to BBFILES
BBFILES += "${LAYERDIR}/recipes-*/*/*.bb \
	${LAYERDIR}/recipes-*/*/*.bbappend"

BBFILE_COLLECTIONS += "project"
BBFILE_PATTERN_project = "^${LAYERDIR}/"
BBFILE_PRIORITY_project = "7"

LAYERVERSION_project = "5"
LAYERSERIES_COMPAT_project = "zeus dunfell"
```
